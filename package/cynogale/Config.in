## package/helium-gateway-config/Config.in
```kconfig
config BR2_PACKAGE_HELIUM_GATEWAY_CONFIG
	bool "helium-gateway-config"
	help
	  https://github.com/helium/gateway-config
```

## package/helium-gateway-mfr-rs/Config.in
```kconfig
config BR2_PACKAGE_HELIUM_GATEWAY_MFR_RS
	bool "helium-gateway-mfr-rs"
	help
	  https://github.com/helium/gateway-mfr-rs
```

## package/helium-gateway-mfr/Config.in
```kconfig
config BR2_PACKAGE_HELIUM_GATEWAY_MFR
	bool "helium-gateway-mfr"
	help
	  https://github.com/helium/gateway_mfr
```

## package/helium-miner/Config.in
```kconfig
config BR2_PACKAGE_HELIUM_MINER
	bool "helium-miner"
	help
	  https://github.com/helium/miner
```

## package/helium-packet-forwarder-sx1301/Config.in
```kconfig
config BR2_PACKAGE_HELIUM_PACKET_FORWARDER_SX1301
	bool "helium-packet-forwarder-sx1301"
	help
	  https://github.com/helium/packet_forwarder
```

## package/helium-packet-forwarder-sx1302/Config.in
```kconfig
config BR2_PACKAGE_HELIUM_PACKET_FORWARDER_SX1302
	bool "helium-packet-forwarder-sx1302"
	help
	  https://github.com/helium/sx1302_hal
```

## package/helium-packet-forwarder/Config.in
```kconfig
config BR2_PACKAGE_HELIUM_PACKET_FORWARDER
	bool "helium-packet-forwarder"
	help
	  https://github.com/helium/packet_forwarder
```

## package/python-pyatecc/Config.in
```kconfig
config BR2_PACKAGE_PYTHON_PYATECC
	bool "python-pyatecc"
	help
	  Python package for Microchip's ATECC508/ATECC608 cryptographic co-processors with secure hardware-based key storage.

	  https://github.com/ccrisan/pyatecc
```
